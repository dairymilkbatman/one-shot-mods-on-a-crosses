## config/west.yml
```yaml
manifest:
  defaults:
    revision: main
  remotes:
    - name: Good-Great-Grand-Wonderful
      url-base: https://github.com/Good-Great-Grand-Wonderful
    - name: caksoylar
      url-base: https://github.com/caksoylar
  projects:
    - name: crosses-v2-zmk-firmware
      remote: Good-Great-Grand-Wonderful
      import: config/west.yml
    - name: zmk-smart-toggle
      remote: caksoylar
      revision: main
  self:
    path: config
```
